## board/vendor/ss522v100/Kconfig
```kconfig
if TARGET_SS522V100

config SYS_BOARD
	default "ss522v100"

config SYS_VENDOR
	default "vendor"

config SYS_SOC
	default "ss522v100"

config SYS_CONFIG_NAME
	default "ss522v100"

endif
```

## board/vendor/ss522v101/Kconfig
```kconfig
if TARGET_SS522V101

config SYS_BOARD
	default "ss522v101"

config SYS_VENDOR
	default "vendor"

config SYS_SOC
	default "ss522v101"

config SYS_CONFIG_NAME
	default "ss522v101"

endif
```

## board/vendor/ss524v100/Kconfig
```kconfig
if TARGET_SS524V100

config SYS_BOARD
	default "ss524v100"

config SYS_VENDOR
	default "vendor"

config SYS_SOC
	default "ss524v100"

config SYS_CONFIG_NAME
	default "ss524v100"

endif
```

## board/vendor/ss528v100/Kconfig
```kconfig
if TARGET_SS528V100

config SYS_BOARD
	default "ss528v100"

config SYS_VENDOR
	default "vendor"

config SYS_SOC
	default "ss528v100"

config SYS_CONFIG_NAME
	default "ss528v100"

endif
```

## board/vendor/ss615v100/Kconfig
```kconfig
if TARGET_SS615V100

config SYS_BOARD
	default "ss615v100"

config SYS_VENDOR
	default "vendor"

config SYS_SOC
	default "ss615v100"

config SYS_CONFIG_NAME
	default "ss615v100"

endif
```

## board/vendor/ss625v100/Kconfig
```kconfig
if TARGET_SS625V100

config SYS_BOARD
	default "ss625v100"

config SYS_VENDOR
	default "vendor"

config SYS_SOC
	default "ss625v100"

config SYS_CONFIG_NAME
	default "ss625v100"

endif
```

## board/vendor/ss927v100/Kconfig
```kconfig
if TARGET_SS927V100

config SYS_BOARD
	default "ss927v100"

config SYS_VENDOR
	default "vendor"

config SYS_SOC
	default "ss927v100"

config SYS_CONFIG_NAME
	default "ss927v100"

endif
```

## board/vendor/ss928v100/Kconfig
```kconfig
if TARGET_SS928V100

config SYS_BOARD
	default "ss928v100"

config SYS_VENDOR
	default "vendor"

config SYS_SOC
	default "ss928v100"

config SYS_CONFIG_NAME
	default "ss928v100"

endif
```

## product/security_subsys/Kconfig
```kconfig
config CIPHER_ENABLE
	bool "cipher enable"

config KLAD_ENABLE
	bool "klad enable"
	depends on TARGET_SS928V100 || TARGET_SS927V100

config OTP_ENABLE
	bool "otp enable"
	depends on TARGET_SS528V100 || TARGET_SS927V100 ||TARGET_SS928V100 || TARGET_SS625V100 || TARGET_SS524V100 ||  TARGET_SS522V101 || TARGET_SS522V100 || TARGET_SS615V100
```

## product/update/Kconfig
```kconfig
config AUTO_UPDATE
	bool "auto update"
	select FS_FAT

config AUTO_SD_UPDATE
        bool "auto sd update"
	depends on AUTO_UPDATE
	depends on !TARGET_SS528V100 && !TARGET_SS625V100 && !TARGET_SS524V100 && !TARGET_SS615V100  && !TARGET_SS522V101 && !TARGET_SS522V100

config AUTO_USB_UPDATE
        bool "auto usb update"
        select USB
	select USB_GADGET
	depends on AUTO_UPDATE

config AUTO_UPDATE_ADAPTATION
	bool "auto update adaptation"
	depends on AUTO_UPDATE
```
